## conf/layer.conf
```bitbake
# We have a conf and classes directory, add to BBPATH
BBPATH .= ":${LAYERDIR}"

# We have a packages directory, add to BBFILES
BBFILES += "${LAYERDIR}/recipes-*/*/*.bb \
            ${LAYERDIR}/recipes-*/*/*.bbappend"

BBFILE_COLLECTIONS += "3b6"
BBFILE_PATTERN_3b6 := "^${LAYERDIR}/"
BBFILE_PRIORITY_3b6 = "10"

LAYERDEPENDS_3b6 = "fsl-arm fsl-arm-extra"
```

## conf/machine/include/mx6q-tera-he-common.inc
```bitbake
# Provides the i.MX6 Tera-he common settings

require conf/machine/include/imx-base.inc
require conf/machine/include/tune-cortexa9.inc

SERIAL_CONSOLE = "115200 ttymxc1"

MACHINE_FIRMWARE_append_mx6 = " linux-firmware-ath6k"

MACHINE_FEATURES += " pci wifi bluetooth"
```

## conf/machine/tera-he-dep.conf
```bitbake
#@TYPE: Machine
#@NAME: Tera-HE Depopulated
#@SOC: i.MX6
#@DESCRIPTION: Machine configuration for 3B6 Tera-HE Depopulated
#@MAINTAINER: Dario Pennisi <dario@iptronix.com>

require conf/machine/include/mx6q-tera-he-common.inc

SOC_FAMILY = "mx6:mx6q"

KERNEL_DEVICETREE = "imx6q-tera-he-dep.dtb"
PREFERRED_VERSION_linux-imx = "3.14.38"
PREFERRED_VERSION_linux-imx-mfgtool = "3.14.38"

UBOOT_CONFIG ??= "sd"
UBOOT_CONFIG[sd] = "mx6q-tera-he-dep_config,sdcard"
UBOOT_CONFIG[mfgtool] = "mx6q-tera-he-dep_config"
# PREFERRED_VERSION_u-boot-fslc = "2015.10"
PREFERRED_VERSION_u-boot-fslc = "v2015.10+gitAUTOINC+1b6aee73e6"
# PREFERRED_VERSION_u-boot-fslc = "2016.03"
```

## conf/machine/tera-he.conf
```bitbake
#@TYPE: Machine
#@NAME: Tera-HE 
#@SOC: i.MX6
#@DESCRIPTION: Machine configuration for 3B6 Tera-HE
#@MAINTAINER: Dario Pennisi <dario@iptronix.com>

require conf/machine/include/mx6q-tera-he-common.inc

SOC_FAMILY = "mx6:mx6q"

KERNEL_DEVICETREE = "imx6q-tera-he.dtb"

# PREFERRED_VERSION_linux-imx = "3.14.38"
PREFERRED_PROVIDER_virtual/kernel = "linux-fslc-imx"
PREFERRED_VERSION_linux-fslc-imx = "4.1-1.0.x+gitAUTOINC+3617c73273"

PREFERRED_VERSION_linux-imx-mfgtool = "3.14.38"

UBOOT_CONFIG ??= "sd"
UBOOT_CONFIG[sd] = "mx6q-tera-he_config,sdcard"
UBOOT_CONFIG[mfgtool] = "mx6q-tera-he_config"
# PREFERRED_VERSION_u-boot-fslc = "2015.10"
PREFERRED_VERSION_u-boot-fslc = "v2015.10+gitAUTOINC+1b6aee73e6"
# PREFERRED_VERSION_u-boot-fslc = "2016.03"
```
